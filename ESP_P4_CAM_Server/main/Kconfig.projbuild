## ESP_P4_CAM_Server/main/Kconfig.projbuild
```kconfig
menu "Example Configuration"
    
    config EXAMPLE_CAMERA_VIDEO_BUFFER_NUMBER
        int "Camera video buffer number"
        default 2
        help
            Number of video buffers for the camera sensor.
            
            More buffers provide better performance and reduce frame drops,
            but consume more memory. Recommended range: 2-4 buffers.
            
            - 2 buffers: Minimum for basic operation
            - 3-4 buffers: Better performance for smooth streaming
            - Higher values: May improve performance but increase memory usage

    config EXAMPLE_JPEG_COMPRESSION_QUALITY
        int "JPEG compression quality (%)"
        default 80
        range 1 100
        help
            JPEG compression quality percentage (1-100).

            Higher values produce better image quality but larger data streams:
            - 90-100: Excellent quality, high bandwidth usage
            - 70-90: Good quality, moderate bandwidth (recommended for UVC)
            - 50-70: Acceptable quality, lower bandwidth
            - 1-50: Poor quality, minimal bandwidth

            For UVC streaming, consider the USB bandwidth limitations
            and host system capabilities when choosing quality level.

            Recommended: 80 for balanced quality and performance.

    config EXAMPLE_HTTP_PART_BOUNDARY
        string "HTTP part boundary"
        default "123456789000000000000987654321"
        help
            HTTP multipart boundary string used for MJPEG streaming.
            
            This boundary separates different parts in the HTTP multipart response.
            Must be unique and not appear in the video data. The default value
            is designed to be unique and safe for most applications.
    
    config EXAMPLE_MDNS_INSTANCE
        string "mDNS instance"
        default "web-cam"
        help
            mDNS instance name for service discovery.
            
            This name will be used to identify the camera service on the network.
            Other devices can discover this camera using this instance name
            through mDNS/Bonjour protocols.
    
    config EXAMPLE_MDNS_HOST_NAME
        string "mDNS host name"
        default "esp-web"
        help
            mDNS host name for the ESP32 device.
            
            This hostname will be used for network identification and can be
            accessed as "esp-web.local" on the local network (if mDNS is supported
            by the client device).

    config EXAMPLE_ENABLE_GPIO_BUTTON_CONTROL
        bool "Enable GPIO button control"
        default y
        help
            Enable three hardware buttons for capture, preview toggle, and
            15-second recording control.

    if EXAMPLE_ENABLE_GPIO_BUTTON_CONTROL
        config EXAMPLE_BUTTON_GPIO_CAPTURE
            int "Capture button GPIO"
            range 0 54
            default 46
            help
                Active-low button GPIO for still image capture.

        config EXAMPLE_BUTTON_GPIO_PREVIEW
            int "Preview button GPIO"
            range 0 54
            default 47
            help
                Active-low button GPIO for preview stream on/off toggle.

        config EXAMPLE_BUTTON_GPIO_RECORD
            int "15-second record button GPIO"
            range 0 54
            default 48
            help
                Active-low button GPIO for 15-second MJPEG recording trigger.

        config EXAMPLE_BUTTON_DEBOUNCE_MS
            int "Button debounce time (ms)"
            range 10 200
            default 40
            help
                Debounce time for hardware buttons.

        config EXAMPLE_RECORD_DURATION_SEC
            int "Record duration (seconds)"
            range 1 300
            default 15
            help
                Duration for the record button action.

        config EXAMPLE_PC_RECEIVER_BASE_URL
            string "PC receiver base URL"
            default ""
            help
                Base URL of the PC-side helper service, for example:
                http://192.168.219.100:8088
                Leave empty to disable push/upload from hardware buttons.
    endif

    config EXAMPLE_ENABLE_MIPI_CSI_CROP
        bool "Enable crop for MIPI-CSI video device"
        default n
        depends on EXAMPLE_ENABLE_MIPI_CSI_CAM_SENSOR && SOC_ISP_CROP_SUPPORTED
    
    if EXAMPLE_ENABLE_MIPI_CSI_CROP
        config EXAMPLE_MIPI_CSI_CROP_TOP_LEFT_H
            int "Crop region top-left horizontal coordinate"
            default 0
            help
                Horizontal coordinate of the top-left corner for the crop.
                Must be an even number and less than bottom-right horizontal coordinate.

        config EXAMPLE_MIPI_CSI_CROP_TOP_LEFT_V
            int "Crop region top-left vertical coordinate"
            default 0
            help
                Vertical coordinate of the top-left corner for the crop.
                Must be an even number and less than bottom-right vertical coordinate.

        config EXAMPLE_MIPI_CSI_CROP_WIDTH
            int "Crop region width"
            default 640
            help
                Width of the crop region in pixels.
                Must be greater than 0 and not exceed the sensor output width.

        config EXAMPLE_MIPI_CSI_CROP_HEIGHT
            int "Crop region height"
            default 480
            help
                Height of the crop region in pixels.
                Must be greater than 0 and not exceed the sensor output height.
    endif
endmenu
```
